# file: 4led_button.ioc
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Mcu.Family=STM32F1
Mcu.Name=STM32F103C(8-B)Tx
Mcu.Package=LQFP48
NVIC.PriorityGroup=NVIC_PRIORITYGROUP_4
PA13.Mode=Serial_Wire
PA13.Signal=SYS_JTMS-SWDIO
PA14.Mode=Serial_Wire
PA14.Signal=SYS_JTCK-SWCLK
ProjectManager.HeapSize=0x200
ProjectManager.StackSize=0x400
ProjectManager.TargetToolchain=STM32CubeIDE
RCC.APB1Freq_Value=8000000
RCC.APB2Freq_Value=8000000
board=custom

// file: Core/Src/main.c
/* USER CODE BEGIN Header */
/**
  ******************************************************************************
  * @file           : main.c
  * @brief          : Main program body
  ******************************************************************************
  * @attention
  *
  * Copyright (c) 2026 STMicroelectronics.
  * All rights reserved.
  *
  * This software is licensed under terms that can be found in the LICENSE file
  * in the root directory of this software component.
  * If no LICENSE file comes with this software, it is provided AS-IS.
  *
  ******************************************************************************
  */
/* USER CODE END Header */
#include "main.h"
#include "F.h"

/* USER CODE BEGIN Includes */
/* LED pins */
#define LED1_PIN  GPIOx_Pin_0
#define LED2_PIN  GPIOx_Pin_1
#define LED3_PIN  GPIOx_Pin_2
#define LED4_PIN  GPIOx_Pin_3
#define LED_PORT  GPIOA

/* Button pins */
#define BTN1_PIN  GPIOx_Pin_0
#define BTN2_PIN  GPIOx_Pin_1
#define BTN_PORT  GPIOB

#define STEP_DELAY  300   /* ms mỗi bước (thay đổi tuỳ ý) */
#define DEBOUNCE_MS  50

void delay_ms(uint32_t ms);
static void setLEDs(uint8_t l1, uint8_t l2, uint8_t l3, uint8_t l4);
static void runMode1(void);
static void runMode2(void);

typedef enum { MODE_IDLE = 0, MODE_1, MODE_2 } AppMode;

static AppMode currentMode = MODE_IDLE;

/* ---- helpers ---- */
static void setLEDs(uint8_t l1, uint8_t l2, uint8_t l3, uint8_t l4)
{
	GPIOx_Write(LED_PORT, LED1_PIN, l1 ? 1 : 0);
	GPIOx_Write(LED_PORT, LED2_PIN, l2 ? 1 : 0);
	GPIOx_Write(LED_PORT, LED3_PIN, l3 ? 1 : 0);
	GPIOx_Write(LED_PORT, LED4_PIN, l4 ? 1 : 0);
}

static void allOff(void) { setLEDs(0,0,0,0); }

// Chu trình 1
static void runMode1(void)
{

    const uint8_t seq[6][4] = {
        {1,0,0,0},
        {0,1,0,0},
        {0,0,1,0},
        {0,0,0,1},
        {0,0,1,0},
        {0,1,0,0},
    };
    for (uint8_t i = 0; i < 6; i++)
    {
        /* Thoát sớm nếu nút bấm thay đổi */
        if (GPIOx_Read(BTN_PORT, BTN1_PIN) == 0 ||
        		GPIOx_Read(BTN_PORT, BTN2_PIN) == 0) return;

        setLEDs(seq[i][0], seq[i][1], seq[i][2], seq[i][3]);
        HAL_Delay(STEP_DELAY);
    }
}

//  Chu trình 2
static void runMode2(void)
{
    const uint8_t seq[10][4] = {
        {1,0,0,1},
        {0,1,1,0},
        {1,0,0,1},
        {0,0,0,0},
        {1,1,1,1},
        {0,0,0,0},
        {1,1,0,0},
        {0,0,1,1},
        {1,0,1,0},
        {0,1,0,1},
    };
    for (uint8_t i = 0; i < 10; i++)
    {
        if (GPIOx_Read(BTN_PORT, BTN1_PIN) == 0 ||
        		GPIOx_Read(BTN_PORT, BTN2_PIN) == 0) return;

        setLEDs(seq[i][0], seq[i][1], seq[i][2], seq[i][3]);
        HAL_Delay(STEP_DELAY);
    }
}

// Đọc nút có debounce
static AppMode readButtons(void)
{
    if (GPIOx_Read(BTN_PORT, BTN1_PIN) == 0)
    {
    	HAL_Delay(DEBOUNCE_MS);
        if (GPIOx_Read(BTN_PORT, BTN1_PIN) == 0)
        {
            while (GPIOx_Read(BTN_PORT, BTN1_PIN) == 0); /* chờ nhả */
            return MODE_1;
        }
    }
    if (GPIOx_Read(BTN_PORT, BTN2_PIN) == 0)
    {
    	HAL_Delay(DEBOUNCE_MS);
        if (GPIOx_Read(BTN_PORT, BTN2_PIN) == 0)
        {
            while (GPIOx_Read(BTN_PORT, BTN2_PIN) == 0);
            return MODE_2;
        }
    }
    return currentMode; /* giữ nguyên chế độ cũ */
}

/* USER CODE END Includes */

void SystemClock_Config(void);
static void MX_GPIO_Init(void);

int main(void)
{

  /* MCU Configuration--------------------------------------------------------*/

  /* Reset of all peripherals, Initializes the Flash interface and the Systick. */
  HAL_Init();

  /* Configure the system clock */
  SystemClock_Config();

  /* Initialize all configured peripherals */
  MX_GPIO_Init();
  /* USER CODE BEGIN 2 */

  /* ✅ ĐÚNG — input + pull-up */
  GPIOx_Init(GPIOB, GPIOx_Pin_0, INPUT_MODE, PULL_UP, OUTPUT_SPEED_2MHZ );
  GPIOx_Init(GPIOB, GPIOx_Pin_1, INPUT_MODE, PULL_UP, OUTPUT_SPEED_2MHZ );
  GPIOx_Init(GPIOA, GPIOx_Pin_0,OUT_PUSH_PULL  , NO_PULL, OUTPUT_SPEED_10MHZ   );
  GPIOx_Init(GPIOA, GPIOx_Pin_1,OUT_PUSH_PULL  , NO_PULL, OUTPUT_SPEED_10MHZ   );
  GPIOx_Init(GPIOA, GPIOx_Pin_2,OUT_PUSH_PULL  , NO_PULL, OUTPUT_SPEED_10MHZ  );
  GPIOx_Init(GPIOA, GPIOx_Pin_3,OUT_PUSH_PULL  , NO_PULL, OUTPUT_SPEED_10MHZ  );
  allOff();
  /* USER CODE END 2 */

  /* Infinite loop */
  while (1)
  {

    /* USER CODE BEGIN 3 */
      currentMode = readButtons();

      switch (currentMode)
      {
          case MODE_1: runMode1(); break;
          case MODE_2: runMode2(); break;
          default:     allOff();  break;
      }
  }
  /* USER CODE END 3 */
}

void SystemClock_Config(void)
{
  RCC_OscInitTypeDef RCC_OscInitStruct = {0};
  RCC_ClkInitTypeDef RCC_ClkInitStruct = {0};

  /** Initializes the RCC Oscillators according to the specified parameters
  * in the RCC_OscInitTypeDef structure.
  */
  RCC_OscInitStruct.OscillatorType = RCC_OSCILLATORTYPE_HSI;
  RCC_OscInitStruct.HSIState = RCC_HSI_ON;
  RCC_OscInitStruct.HSICalibrationValue = RCC_HSICALIBRATION_DEFAULT;
  RCC_OscInitStruct.PLL.PLLState = RCC_PLL_NONE;
  if (HAL_RCC_OscConfig(&RCC_OscInitStruct) != HAL_OK)
  {
    Error_Handler();
  }

  /** Initializes the CPU, AHB and APB buses clocks
  */
  RCC_ClkInitStruct.ClockType = RCC_CLOCKTYPE_HCLK|RCC_CLOCKTYPE_SYSCLK
                              |RCC_CLOCKTYPE_PCLK1|RCC_CLOCKTYPE_PCLK2;
  RCC_ClkInitStruct.SYSCLKSource = RCC_SYSCLKSOURCE_HSI;
  RCC_ClkInitStruct.AHBCLKDivider = RCC_SYSCLK_DIV1;
  RCC_ClkInitStruct.APB1CLKDivider = RCC_HCLK_DIV1;
  RCC_ClkInitStruct.APB2CLKDivider = RCC_HCLK_DIV1;

  if (HAL_RCC_ClockConfig(&RCC_ClkInitStruct, FLASH_LATENCY_0) != HAL_OK)
  {
    Error_Handler();
  }
}

static void MX_GPIO_Init(void)
{

  /* GPIO Ports Clock Enable */
  __HAL_RCC_GPIOA_CLK_ENABLE();
  __HAL_RCC_GPIOB_CLK_ENABLE();

}

void Error_Handler(void)
{
  __disable_irq();
  while (1)
  {
  }
}

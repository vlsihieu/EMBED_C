# file: ledblink.ioc
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Mcu.Family=STM32F1
Mcu.Name=STM32F103C(8-B)Tx
Mcu.Package=LQFP48
NVIC.PriorityGroup=NVIC_PRIORITYGROUP_4
PA13.Mode=Serial_Wire
PA13.Signal=SYS_JTMS-SWDIO
PA14.Mode=Serial_Wire
PA14.Signal=SYS_JTCK-SWCLK
ProjectManager.HeapSize=0x200
ProjectManager.StackSize=0x400
ProjectManager.TargetToolchain=STM32CubeIDE
RCC.APB1Freq_Value=8000000
RCC.APB2Freq_Value=8000000
board=custom

// file: Core/Src/main.c
/* USER CODE BEGIN Header */
/**
  ******************************************************************************
  * @file           : main.c
  * @brief          : Main program body
  ******************************************************************************
  * @attention
  *
  * Copyright (c) 2026 STMicroelectronics.
  * All rights reserved.
  *
  * This software is licensed under terms that can be found in the LICENSE file
  * in the root directory of this software component.
  * If no LICENSE file comes with this software, it is provided AS-IS.
  *
  ******************************************************************************
  */
/* USER CODE END Header */
#include "main.h"
#include "rgt.h"
#include "cnt.h"

/* USER CODE BEGIN Includes */
#define LED1       PIN_0
#define LED2       PIN_1
#define LED3       PIN_2
#define LED4       PIN_3

#define btn1       PIN_0
#define btn2       PIN_1

/* USER CODE END Includes */

/* USER CODE BEGIN PTD */
typedef enum{
	MODE_IDLE = 0,
	MODE_1,
	MODE_2,
}app_mode;

static app_mode current_mode = MODE_IDLE;

/* USER CODE END PTD */

/* USER CODE BEGIN PD */
static void set_led(uint8_t l1, uint8_t l2, uint8_t l3, uint8_t l4);
static void ledoff();
static void runmode1(void);
static void runmode2(void);
static app_mode readbutton(void);
/* USER CODE END PD */

/* USER CODE BEGIN PM */
static void set_led(uint8_t l1, uint8_t l2, uint8_t l3, uint8_t l4){
	GPIO_write(GPIOA,LED1,l1?1:0);
	GPIO_write(GPIOA,LED2,l2?1:0);
	GPIO_write(GPIOA,LED3,l3?1:0);
	GPIO_write(GPIOA,LED4,l4?1:0);
}

static void ledoff(){
	set_led(0,0,0,0);
}

static void runmode1(void){
	const uint8_t seq[4][4]= {
			{1,0,0,1},
			{0,1,1,0},
			{1,0,1,0},
			{0,1,0,1},
	};
	for(uint8_t i = 0;i<4;i++){
		if(GPIO_read(GPIOB,btn1)==0 ||
				GPIO_read(GPIOB,btn2)==0){
			return;
		}
		set_led(seq[i][0],seq[i][1],seq[i][2],seq[i][3]);
		delayms(TIM2,1000);
	}
}

static void runmode2(void){
	const uint8_t seq[6][4]= {
			{1,1,0,0},
			{0,0,1,1},
			{0,1,1,0},
			{1,0,0,0},
			{1,1,0,0},
			{1,1,1,0},

	};
	for(uint8_t i = 0;i<6;i++){
		if(GPIO_read(GPIOB,btn1)==0 ||
				GPIO_read(GPIOB,btn2)==0){
			return;
		}
		set_led(seq[i][0],seq[i][1],seq[i][2],seq[i][3]);
		delayms(TIM2,1000);
	}
}

static app_mode readbutton(void){
	if(GPIO_read(GPIOB,btn1)==0){
		delayms(TIM2,50);
		if(GPIO_read(GPIOB,btn1)==0){
			while(GPIO_read(GPIOB,btn1)==0);
			return MODE_1;

		}
	}
	if(GPIO_read(GPIOB,btn2)==0){
		delayms(TIM2,50);
		if(GPIO_read(GPIOB,btn2)==0){
			while(GPIO_read(GPIOB,btn2)==0);
			return MODE_2;

		}
	}
	return current_mode;
}

/* USER CODE END PM */

void SystemClock_Config(void);
static void MX_GPIO_Init(void);

int main(void)
{

  /* MCU Configuration--------------------------------------------------------*/

  /* Reset of all peripherals, Initializes the Flash interface and the Systick. */
  HAL_Init();
  TIMx_init(TIM2);

  /* Configure the system clock */
  SystemClock_Config();

  /* Initialize all configured peripherals */
  MX_GPIO_Init();
  /* USER CODE BEGIN 2 */
  GPIO_init(GPIOA,LED1,OUTPUT_MODE_10MHZ,PUSH_PULL,NO_PULL);
  GPIO_init(GPIOA,LED2,OUTPUT_MODE_10MHZ,PUSH_PULL,NO_PULL);
  GPIO_init(GPIOA,LED3,OUTPUT_MODE_10MHZ,PUSH_PULL,NO_PULL);
  GPIO_init(GPIOA,LED4,OUTPUT_MODE_10MHZ,PUSH_PULL,NO_PULL);
  GPIO_init(GPIOB,btn1,INPUT_MODE,PULL_UP_DOWN,PULL_UP);
  GPIO_init(GPIOB,btn2,INPUT_MODE,PULL_UP_DOWN,PULL_UP);
  ledoff();

  /* USER CODE END 2 */

  /* Infinite loop */
  while (1)
  {

    /* USER CODE BEGIN 3 */
	  current_mode = readbutton();

	  switch(current_mode){
	  case MODE_1: runmode1(); break;
	  case MODE_2: runmode2(); break;
	  default:     ledoff(); break;
	  }
  }
  /* USER CODE END 3 */
}

void SystemClock_Config(void)
{
  RCC_OscInitTypeDef RCC_OscInitStruct = {0};
  RCC_ClkInitTypeDef RCC_ClkInitStruct = {0};

  /** Initializes the RCC Oscillators according to the specified parameters
  * in the RCC_OscInitTypeDef structure.
  */
  RCC_OscInitStruct.OscillatorType = RCC_OSCILLATORTYPE_HSI;
  RCC_OscInitStruct.HSIState = RCC_HSI_ON;
  RCC_OscInitStruct.HSICalibrationValue = RCC_HSICALIBRATION_DEFAULT;
  RCC_OscInitStruct.PLL.PLLState = RCC_PLL_NONE;
  if (HAL_RCC_OscConfig(&RCC_OscInitStruct) != HAL_OK)
  {
    Error_Handler();
  }

  /** Initializes the CPU, AHB and APB buses clocks
  */
  RCC_ClkInitStruct.ClockType = RCC_CLOCKTYPE_HCLK|RCC_CLOCKTYPE_SYSCLK
                              |RCC_CLOCKTYPE_PCLK1|RCC_CLOCKTYPE_PCLK2;
  RCC_ClkInitStruct.SYSCLKSource = RCC_SYSCLKSOURCE_HSI;
  RCC_ClkInitStruct.AHBCLKDivider = RCC_SYSCLK_DIV1;
  RCC_ClkInitStruct.APB1CLKDivider = RCC_HCLK_DIV1;
  RCC_ClkInitStruct.APB2CLKDivider = RCC_HCLK_DIV1;

  if (HAL_RCC_ClockConfig(&RCC_ClkInitStruct, FLASH_LATENCY_0) != HAL_OK)
  {
    Error_Handler();
  }
}

static void MX_GPIO_Init(void)
{

  /* GPIO Ports Clock Enable */
  __HAL_RCC_GPIOA_CLK_ENABLE();
  __HAL_RCC_GPIOB_CLK_ENABLE();
}

void Error_Handler(void)
{
  __disable_irq();
  while (1)
  {
  }
}
